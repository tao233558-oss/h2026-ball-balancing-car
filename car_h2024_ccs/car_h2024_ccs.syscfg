// ══ Generated by scaffold.py ══
// Adding GPIO instances: use unique variable names (GPIO2, GPIO3, ...)
// Do NOT reuse GPIO1 — it is already declared above.
// Instance $name ≠ pin $name — both must be globally unique.
// Always grep ti_msp_dl_config.h after SysConfig to confirm macro names.

/**
 * These arguments were used when this file was generated. They will be automatically applied on subsequent loads
 * via the GUI or CLI. Run CLI with '--help' for additional information on how to override these arguments.
 */
//@cliArgs --device "MSPM0G350X" --package "LQFP-64(PM)" --part "Default" --product "mspm0_sdk@2.00.01.00"
//@v2CliArgs --device "MSPM0G3507" --package "LQFP-64(PM)"
// @cliArgs --board /ti/boards/LP_MSPM0G3507 --rtos nortos

/**
 * Import the modules used in this configuration.
 */
const SYSCTL = scripting.addModule("/ti/driverlib/SYSCTL");

// Migration note: legacy application code performs the active 80 MHz clock
// and peripheral initialization in ml_libs/ml_system.c and the ml_* drivers.
// This minimal SysConfig remains the CCS device/package source and generates
// ti_msp_dl_config.h plus the device/linker build artifacts.

/**
 * Write custom configuration values to the imported modules.
 */

const Board = scripting.addModule("/ti/driverlib/Board");

SYSCTL.forceDefaultClkConfig = true;
